## main/Kconfig.projbuild
```kconfig
menu "Tractor Dash"

    config DASH_SIMULATE_CAN
        bool "Generate synthetic CAN frames (bench only)"
        default n
        help
            Feed fake frames for every decoded ID through the normal decode path
            so the dash can be exercised without a bus. Never enable on the
            tractor: the values are meaningless and they are logged like real
            frames.

    config DASH_CURRENT_DIVISOR
        int "ISA shunt current divisor"
        default 100
        help
            Raw 0x521 current is divided by this to give amps. The Nextion dash
            used 100. Change only if the shunt scaling changes.

    config DASH_MPH_PER_RPM
        string "Miles per hour per motor RPM"
        default "0.008"
        help
            Speed is derived from motor RPM alone (no wheel sensor):
            mph = rpm * this. 0.008 matches the Nextion dash for the fitted
            final drive.

    config DASH_TZ
        string "POSIX timezone for the on-screen clock"
        default "GMT0BST,M3.5.0/1,M10.5.0"
        help
            Logs are always UTC. This only affects the clock on the dash.

    config DASH_LATITUDE
        string "Latitude for sunrise/sunset (decimal degrees, + = N)"
        default "51.05"
        help
            Used only to compute local sunrise/sunset for the auto-brightness
            fade. Somerset, UK by default. Does not need to be exact — a few
            miles of error shifts sunrise/sunset by well under a minute.

    config DASH_LONGITUDE
        string "Longitude for sunrise/sunset (decimal degrees, + = E)"
        default "-2.85"
        help
            Paired with DASH_LATITUDE. Negative values are west, matching
            Somerset's position west of the Greenwich meridian.

    config DASH_BRIGHTNESS_DAY_PCT
        int "Daytime backlight brightness (%)"
        range 1 100
        default 100
        help
            Backlight level while the sun is up, and the fallback level
            whenever the clock has not been set yet (RTC absent or unset).

    config DASH_BRIGHTNESS_NIGHT_PCT
        int "Night-time backlight brightness (%)"
        range 1 100
        default 40
        help
            Backlight level once fully dark. Kept well above 0 so the dash
            stays legible at night, just dimmer than the daytime glare level.

    config DASH_BRIGHTNESS_FADE_MINUTES
        int "Sunrise/sunset fade half-width (minutes)"
        range 5 120
        default 30
        help
            The backlight fades linearly between day and night brightness
            over a window of this many minutes on each side of the actual
            sunrise/sunset instant (60 minutes total by default), rather than
            switching instantly.

endmenu
```
